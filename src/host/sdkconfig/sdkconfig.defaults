## src/host/sdkconfig/sdkconfig.defaults
```kconfig
#
# Serial flasher config
#
#CONFIG_FLASHMODE_QIO=
#CONFIG_FLASHMODE_DIO=y
#CONFIG_ESPTOOLPY_FLASHMODE="dio"
#CONFIG_ESPTOOLPY_FLASHFREQ_80M=
#CONFIG_ESPTOOLPY_FLASHFREQ_40M=y
#CONFIG_ESPTOOLPY_FLASHFREQ="40m"

#
# ESP32-specific
#
#CONFIG_ESP32_ENABLE_COREDUMP_TO_UART=
#CONFIG_ESP32_PANIC_GDBSTUB=
#CONFIG_ESP32_DEBUG_OCDAWARE=
#CONFIG_ESP32_DEBUG_STUBS_ENABLE=

#
# FreeRTOS
#
#CONFIG_FREERTOS_UNICORE=

## clock add
#CONFIG_ESP32_WIFI_TASK_PINNED_TO_CORE_0=y
#CONFIG_ESP32_WIFI_TASK_PINNED_TO_CORE_1=


# PPPOS
CONFIG_LWIP_PPP_SUPPORT=y
CONFIG_LWIP_PPP_NOTIFY_PHASE_SUPPORT=y
CONFIG_LWIP_PPP_PAP_SUPPORT=y
CONFIG_LWIP_TCPIP_TASK_STACK_SIZE=4096
# Do not enable IPV6 in dte<->dce link local
CONFIG_LWIP_PPP_ENABLE_IPV6=n


#
# Example Configuration
#
# CONFIG_EXAMPLE_MODEM_DEVICE_SIM800 is not set
CONFIG_EXAMPLE_MODEM_DEVICE_BG96=y
CONFIG_EXAMPLE_MODEM_PPP_AUTH_NONE=y
# CONFIG_EXAMPLE_SEND_MSG is not set

#
# UART Configuration
#
CONFIG_EXAMPLE_MODEM_UART_TX_PIN=25
CONFIG_EXAMPLE_MODEM_UART_RX_PIN=26
CONFIG_EXAMPLE_MODEM_UART_RTS_PIN=27
CONFIG_EXAMPLE_MODEM_UART_CTS_PIN=23
CONFIG_EXAMPLE_MODEM_UART_EVENT_TASK_STACK_SIZE=3072
CONFIG_EXAMPLE_MODEM_UART_EVENT_TASK_PRIORITY=5
CONFIG_EXAMPLE_MODEM_UART_EVENT_QUEUE_SIZE=30
CONFIG_EXAMPLE_MODEM_UART_PATTERN_QUEUE_SIZE=20
CONFIG_EXAMPLE_MODEM_UART_TX_BUFFER_SIZE=512
CONFIG_EXAMPLE_MODEM_UART_RX_BUFFER_SIZE=1024
# end of UART Configuration
# end of Example Configuration
```
